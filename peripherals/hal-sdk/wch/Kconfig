## peripherals/hal-sdk/wch/Kconfig
```kconfig
menu "WCH HAL & SDK Drivers"

source "$PKGS_DIR/packages/peripherals/hal-sdk/wch/ch32v307_sdk/Kconfig"
source "$PKGS_DIR/packages/peripherals/hal-sdk/wch/ch32v307_sdk_rtt_patch/Kconfig"

endmenu
```

## peripherals/hal-sdk/wch/ch32v307_sdk/Kconfig
```kconfig
# Kconfig file for package ch32v307_sdk
menuconfig PKG_USING_CH32V307_SDK
    bool "Upstream CH32V307 SDK"
    select PKG_USING_CH32V307_SDK_RTT_PATCH
    default n

if PKG_USING_CH32V307_SDK

    config PKG_CH32V307_SDK_PATH
        string
        default "/packages/peripherals/hal-sdk/wch/ch32v307_sdk"

    choice
        prompt "Version"
        help
            Select the package version

        config PKG_USING_CH32V307_SDK_LATEST_VERSION
            bool "latest"
    endchoice

    config PKG_CH32V307_SDK_VER
       string
       default "latest"    if PKG_USING_CH32V307_SDK_LATEST_VERSION

endif
```

## peripherals/hal-sdk/wch/ch32v307_sdk_rtt_patch/Kconfig
```kconfig
# Kconfig file for package ch32v307_sdk_rtt_patch
menuconfig PKG_USING_CH32V307_SDK_RTT_PATCH
    bool "Patch for ch32v307 SDK"
    default n

if PKG_USING_CH32V307_SDK_RTT_PATCH

    config PKG_CH32V307_SDK_RTT_PATCH_PATH
        string
        default "/packages/peripherals/hal-sdk/wch/ch32v307_sdk_rtt_patch"

    choice
        prompt "Version"
        help
            Select the package version

        config PKG_USING_CH32V307_SDK_RTT_PATCH_V207
            bool "v2.7"

        config PKG_USING_CH32V307_SDK_RTT_PATCH_LATEST_VERSION
            bool "latest"
    endchoice

    config PKG_CH32V307_SDK_RTT_PATCH_VER
        string
        default "v2.7"      if PKG_USING_CH32V307_SDK_RTT_PATCH_V207
        default "latest"    if PKG_USING_CH32V307_SDK_RTT_PATCH_LATEST_VERSION

endif
```
